#include "OLED.h"
#include <stdio.h>
#include <string.h>

/*==================================================================*
 *                        局部函数声明                               *
 *==================================================================*/
static void OLED_I2C_Delay(void);
static void OLED_I2C_Start(void);
static void OLED_I2C_Stop(void);
static uint8_t OLED_I2C_SendByte(uint8_t data);
static void OLED_I2C_Write(uint8_t reg, uint8_t data);
static void OLED_SetCursor(uint8_t x, uint8_t y);

/*==================================================================*
 *                        显存缓冲区                                 *
 *==================================================================*/
uint8_t OLED_Buffer[OLED_WIDTH * OLED_PAGES];

/*==================================================================*
 *                        字库数据                                   *
 *==================================================================*/

// ---------- 6×8 ASCII 字库 ----------
static const uint8_t Font_6x8[][6] = {
    {0x00,0x00,0x00,0x00,0x00,0x00}, // sp
    {0x00,0x00,0x00,0x2f,0x00,0x00}, // !
    {0x00,0x00,0x07,0x00,0x07,0x00}, // "
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    {0x00,0x08,0x08,0x2a,0x1c,0x08}, // ~
};

// ---------- 8×16 ASCII 字库 ----------
static const uint8_t Font_8x16[][16] = {
    {0x00,0x00,0x00,0x00,0x00,0x00,0x00,0x00,0x00,0x00,0x00,0x00,0x00,0x00,0x00,0x00}, // sp
    {0x00,0x00,0x00,0xf8,0x00,0x00,0x00,0x00,0x00,0x00,0x00,0x33,0x30,0x00,0x00,0x00}, // !
    {0x00,0x10,0x0c,0x06,0x10,0x0c,0x06,0x00,0x00,0x00,0x00,0x00,0x00,0x00,0x00,0x00}, // "
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    {0x00,0x06,0x01,0x01,0x02,0x02,0x04,0x04,0x00,0x00,0x00,0x00,0x00,0x00,0x00,0x00}, // ~
};

/*==================================================================*
 *                     GPIO 模拟 I2C 时序函数                        *
 *==================================================================*/

/**
  * @brief  I2C 延时（简单的空循环延时）
  */
static void OLED_I2C_Delay(void)
{
    volatile uint32_t t = OLED_I2C_SPEED_DELAY;
    while (t--);
}

/**
  * @brief  I2C 起始信号
  *         SCL 高电平时，SDA 从高到低跳变
  */
static void OLED_I2C_Start(void)
{
    OLED_SDA_H();
    OLED_SCL_H();
    OLED_I2C_Delay();
    OLED_SDA_L();
    OLED_I2C_Delay();
    OLED_SCL_L();
}

/**
  * @brief  I2C 停止信号
  *         SCL 高电平时，SDA 从低到高跳变
  */
static void OLED_I2C_Stop(void)
{
    OLED_SDA_L();
    OLED_SCL_H();
    OLED_I2C_Delay();
    OLED_SDA_H();
    OLED_I2C_Delay();
}

/**
  * @brief  I2C 发送一个字节
  * @param  data  要发送的字节
  * @retval 0 收到 ACK（应答成功），1 收到 NACK（无应答）
  */
static uint8_t OLED_I2C_SendByte(uint8_t data)
{
    for (uint8_t i = 0; i < 8; i++)
    {
        if (data & 0x80)
            OLED_SDA_H();
        else
            OLED_SDA_L();
        OLED_I2C_Delay();
        OLED_SCL_H();
        OLED_I2C_Delay();
        OLED_SCL_L();
        data <<= 1;
    }
    // 释放 SDA，等待从机应答
    OLED_SDA_H();
    OLED_I2C_Delay();
    OLED_SCL_H();
    OLED_I2C_Delay();
    uint8_t ack = OLED_SDA_READ();  // 读取应答位
    OLED_SCL_L();
    return ack;  // 0 = ACK, 1 = NACK
}

/**
  * @brief  通过 GPIO 模拟 I2C 向 SSD1306 写入一个字节
  * @param  reg   0x00 表示命令，0x40 表示数据
  * @param  data  要写入的字节
  */
static void OLED_I2C_Write(uint8_t reg, uint8_t data)
{
    OLED_I2C_Start();
    OLED_I2C_SendByte(OLED_I2C_ADDR);   // 发送设备地址 + 写
    OLED_I2C_SendByte(reg);             // 发送控制字节（命令/数据）
    OLED_I2C_SendByte(data);            // 发送数据
    OLED_I2C_Stop();
}

/*==================================================================*
 *                        底层驱动函数                               *
 *==================================================================*/

/**
  * @brief  设置光标（页地址 + 列地址）
  * @param  x  列坐标（0 ~ OLED_WIDTH - 1）
  * @param  y  页坐标（0 ~ OLED_PAGES - 1）
  */
static void OLED_SetCursor(uint8_t x, uint8_t y)
{
    OLED_WriteCmd(0xB0 + y);                    // 设置页地址
    OLED_WriteCmd(0x10 | ((x >> 4) & 0x0F));    // 设置列地址高 4 位
    OLED_WriteCmd(x & 0x0F);                    // 设置列地址低 4 位
}

/**
  * @brief  GPIO 模拟 I2C 引脚初始化（推挽输出）
  *         将 SCL 和 SDA 配置为开漏输出（外部上拉）或推挽输出
  */
static void OLED_I2C_GPIO_Init(void)
{
    GPIO_InitTypeDef GPIO_InitStruct = {0};

    /* 使能 GPIO 时钟（根据端口自动判断） */
    if (OLED_I2C_SCL_Port == GPIOA || OLED_I2C_SDA_Port == GPIOA)
        __HAL_RCC_GPIOA_CLK_ENABLE();
    if (OLED_I2C_SCL_Port == GPIOB || OLED_I2C_SDA_Port == GPIOB)
        __HAL_RCC_GPIOB_CLK_ENABLE();
    if (OLED_I2C_SCL_Port == GPIOC || OLED_I2C_SDA_Port == GPIOC)
        __HAL_RCC_GPIOC_CLK_ENABLE();
    if (OLED_I2C_SCL_Port == GPIOD || OLED_I2C_SDA_Port == GPIOD)
        __HAL_RCC_GPIOD_CLK_ENABLE();

    /* 配置 SCL 引脚：推挽输出 */
    GPIO_InitStruct.Pin = OLED_I2C_SCL_Pin;
    GPIO_InitStruct.Mode = GPIO_MODE_OUTPUT_PP;
    GPIO_InitStruct.Pull = GPIO_PULLUP;
    GPIO_InitStruct.Speed = GPIO_SPEED_FREQ_HIGH;
    HAL_GPIO_Init(OLED_I2C_SCL_Port, &GPIO_InitStruct);

    /* 配置 SDA 引脚：推挽输出 */
    GPIO_InitStruct.Pin = OLED_I2C_SDA_Pin;
    HAL_GPIO_Init(OLED_I2C_SDA_Port, &GPIO_InitStruct);

    /* 初始状态：SCL 和 SDA 均为高电平（总线空闲） */
    OLED_SCL_H();
    OLED_SDA_H();
}

/**
  * @brief  SSD1306 初始化序列
  */
void OLED_Init(void)
{
#if (OLED_GPIO_INIT_ENABLE == 1)
    /* 自动初始化 I2C 引脚（推挽输出） */
    OLED_I2C_GPIO_Init();
#else
    /* 由用户在 CubeMX 中配置引脚，此处仅将 SCL/SDA 拉高（总线空闲态） */
    OLED_SCL_H();
    OLED_SDA_H();
#endif

    HAL_Delay(100);  // 等待上电稳定

    OLED_WriteCmd(0xAE);    // 关闭显示
    OLED_WriteCmd(0x20);    // 设置内存寻址模式
    OLED_WriteCmd(0x00);    // 水平寻址模式
    OLED_WriteCmd(0xB0);    // 设置页起始地址
    OLED_WriteCmd(0xC8);    // COM 扫描方向：从 COM[N-1] 到 COM0
    OLED_WriteCmd(0x00);    // 设置低列地址
    OLED_WriteCmd(0x10);    // 设置高列地址
    OLED_WriteCmd(0x40);    // 设置显示起始行
    OLED_WriteCmd(0x81);    // 设置对比度
    OLED_WriteCmd(0xFF);    // 对比度最大值
    OLED_WriteCmd(0xA1);    // 段重映射：列 127 映射到 SEG0
    OLED_WriteCmd(0xA6);    // 正常显示（非反色）
    OLED_WriteCmd(0xA8);    // 设置多路复用比
    OLED_WriteCmd(0x3F);    // 1/64 duty（128×64 下为 63）
    OLED_WriteCmd(0xA4);    // 全局显示：按 GDDRAM 内容显示
    OLED_WriteCmd(0xD3);    // 设置显示偏移
    OLED_WriteCmd(0x00);    // 偏移量为 0
    OLED_WriteCmd(0xD5);    // 设置振荡频率
    OLED_WriteCmd(0xF0);    // 默认值
    OLED_WriteCmd(0xD9);    // 设置预充电周期
    OLED_WriteCmd(0x22);    // 默认值
    OLED_WriteCmd(0xDA);    // 设置 COM 引脚配置
    OLED_WriteCmd(0x12);    // 128×64 配置
    OLED_WriteCmd(0xDB);    // 设置 VCOMH 电压
    OLED_WriteCmd(0x20);    // 默认值
    OLED_WriteCmd(0x8D);    // 启用电荷泵
    OLED_WriteCmd(0x14);    // 开启电荷泵
    OLED_WriteCmd(0xAF);    // 开启显示

    OLED_ClearBuffer();
    OLED_Refresh();
}

/**
  * @brief  将显存缓冲区刷新到 OLED
  */
void OLED_Refresh(void)
{
#if (OLED_ROTATE == OLED_ROTATE_180)
    /* 旋转 180°：从右下角开始反向发送 */
    for (uint8_t page = 0; page < OLED_PAGES; page++)
    {
        OLED_SetCursor(OLED_WIDTH - 1, page);
        for (uint8_t col = 0; col < OLED_WIDTH; col++)
        {
            uint16_t idx = page * OLED_WIDTH + (OLED_WIDTH - 1 - col);
            OLED_WriteData(OLED_Buffer[idx]);
        }
    }
#else
    /* 正常方向：逐页逐列发送 */
    for (uint8_t page = 0; page < OLED_PAGES; page++)
    {
        OLED_SetCursor(0, page);
        for (uint8_t col = 0; col < OLED_WIDTH; col++)
        {
            OLED_WriteData(OLED_Buffer[page * OLED_WIDTH + col]);
        }
    }
#endif
}

/**
  * @brief  清空显存缓冲区
  */
void OLED_ClearBuffer(void)
{
    for (uint16_t i = 0; i < sizeof(OLED_Buffer); i++)
    {
        OLED_Buffer[i] = 0x00;
    }
}

/**
  * @brief  全屏填充
  * @param  data  填充数据（0x00 黑，0xFF 白）
  */
void OLED_Fill(uint8_t data)
{
    for (uint16_t i = 0; i < sizeof(OLED_Buffer); i++)
    {
        OLED_Buffer[i] = data;
    }
    OLED_Refresh();
}

/**
  * @brief  开关显示
  * @param  on  0 关闭，1 开启
  */
void OLED_DisplayOn(uint8_t on)
{
    OLED_WriteCmd(on ? 0xAF : 0xAE);
}

/**
  * @brief  设置对比度
  * @param  contrast  0x00 ~ 0xFF
  */
void OLED_SetContrast(uint8_t contrast)
{
    OLED_WriteCmd(0x81);
    OLED_WriteCmd(contrast);
}

/*==================================================================*
 *                        绘图函数                                   *
 *==================================================================*/

/**
  * @brief  画一个像素点
  * @param  x      x 坐标（0 ~ OLED_WIDTH - 1）
  * @param  y      y 坐标（0 ~ OLED_HEIGHT - 1）
  * @param  color  0 熄灭，1 点亮
  */
void OLED_DrawPixel(uint8_t x, uint8_t y, uint8_t color)
{
    if (x >= OLED_WIDTH || y >= OLED_HEIGHT) return;

    uint16_t idx = y / 8 * OLED_WIDTH + x;
    if (color)
        OLED_Buffer[idx] |=  (1 << (y % 8));
    else
        OLED_Buffer[idx] &= ~(1 << (y % 8));
}

/*==================================================================*
 *                        字符显示函数                               *
 *==================================================================*/

/**
  * @brief  显示一个 ASCII 字符
  * @param  x     列起始坐标
  * @param  y     页坐标
  * @param  ch    要显示的字符
  * @param  font  字体：OLED_FONT_6X8 或 OLED_FONT_8X16
  */
void OLED_ShowChar(uint8_t x, uint8_t y, char ch, uint8_t font)
{
    if (ch < 32 || ch > 126) ch = ' ';  // 非可见字符替换为空格
    ch -= 32;  // 字库索引偏移

    if (font == OLED_FONT_6X8)
    {
        if (x + 6 > OLED_WIDTH) return;
        for (uint8_t i = 0; i < 6; i++)
        {
            OLED_Buffer[y * OLED_WIDTH + x + i] = Font_6x8[ch][i];
        }
    }
    else if (font == OLED_FONT_8X16)
    {
        if (x + 8 > OLED_WIDTH || y + 1 >= OLED_PAGES) return;
        // 上半部分：8 列
        for (uint8_t i = 0; i < 8; i++)
        {
            OLED_Buffer[y * OLED_WIDTH + x + i] = Font_8x16[ch][i];
        }
        // 下半部分：8 列
        for (uint8_t i = 0; i < 8; i++)
        {
            OLED_Buffer[(y + 1) * OLED_WIDTH + x + i] = Font_8x16[ch][i + 8];
        }
    }
}

/**
  * @brief  显示字符串
  * @param  x     列起始坐标
  * @param  y     页坐标
  * @param  str   字符串
  * @param  font  字体
  */
void OLED_ShowString(uint8_t x, uint8_t y, const char *str, uint8_t font)
{
    uint8_t step = (font == OLED_FONT_6X8) ? 6 : 8;

    while (*str != '\0')
    {
        /* 自动换行 */
        if (x + step > OLED_WIDTH)
        {
            x = 0;
            y += (font == OLED_FONT_8X16) ? 2 : 1;
        }
        if (y >= OLED_PAGES) break;

        OLED_ShowChar(x, y, *str, font);
        x += step;
        str++;
    }
}

/**
  * @brief  显示无符号整数（十进制）
  * @param  x     列起始坐标
  * @param  y     页坐标
  * @param  num   要显示的数字
  * @param  len   显示位数（0 表示不补零）
  * @param  font  字体
  */
void OLED_ShowNum(uint8_t x, uint8_t y, uint32_t num, uint8_t len, uint8_t font)
{
    char buf[12];
    uint8_t i;

    if (len == 0)
    {
        /* 不补零：自动计算实际长度 */
        sprintf((char *)buf, "%lu", (unsigned long)num);
        OLED_ShowString(x, y, buf, font);
    }
    else
    {
        /* 固定长度，不足前补零 */
        for (i = 0; i < len; i++)
        {
            buf[len - 1 - i] = '0' + (num % 10);
            num /= 10;
        }
        buf[len] = '\0';
        OLED_ShowString(x, y, buf, font);
    }
}

/**
  * @brief  显示浮点数
  * @param  x       列起始坐标
  * @param  y       页坐标
  * @param  num     浮点数
  * @param  intLen  整数部分位数
  * @param  decLen  小数部分位数
  * @param  font    字体
  */
void OLED_ShowFloat(uint8_t x, uint8_t y, double num, uint8_t intLen, uint8_t decLen, uint8_t font)
{
    char buf[24];
    char fmt[10];

    /* 构造格式化字符串，例如 "%4.2f" */
    sprintf(fmt, "%%%u.%uf", intLen + decLen + 1, decLen);
    sprintf(buf, fmt, num);
    OLED_ShowString(x, y, buf, font);
}

/**
  * @brief  显示 16×16 中文点阵（占 2 页）
  * @param  x      列起始坐标
  * @param  y      页坐标
  * @param  index  汉字在字库表中的索引
  * @note   用户需自行提供汉字字库数组，例如：
  *         const uint8_t CN_Table[][32] = { ... };
  *         并在本函数内部引用该数组
  */
void OLED_ShowChinese(uint8_t x, uint8_t y, uint8_t index)
{
    /* 此函数为预留接口，用户可根据需要实现 */
    /* 标准实现需要外部汉字字库数组：
    extern const uint8_t CN_Table[][32];
    for (uint8_t i = 0; i < 16; i++)
    {
        OLED_Buffer[y * OLED_WIDTH + x + i] = CN_Table[index][i];
        OLED_Buffer[(y + 1) * OLED_WIDTH + x + i] = CN_Table[index][i + 16];
    }
    */
}

/*==================================================================*
 *                        图形绘制函数                               *
 *==================================================================*/

/**
  * @brief  画直线（Bresenham 算法）
  */
void OLED_DrawLine(uint8_t x1, uint8_t y1, uint8_t x2, uint8_t y2, uint8_t color)
{
    int16_t dx = (x2 >= x1) ? (x2 - x1) : (x1 - x2);
    int16_t dy = (y2 >= y1) ? (y2 - y1) : (y1 - y2);
    int16_t sx = (x1 < x2) ? 1 : -1;
    int16_t sy = (y1 < y2) ? 1 : -1;
    int16_t err = dx - dy;
    int16_t e2;

    while (1)
    {
        OLED_DrawPixel(x1, y1, color);
        if (x1 == x2 && y1 == y2) break;
        e2 = err * 2;
        if (e2 > -dy) { err -= dy; x1 += sx; }
        if (e2 <  dx) { err += dx; y1 += sy; }
    }
}

/**
  * @brief  画矩形框
  */
void OLED_DrawRect(uint8_t x1, uint8_t y1, uint8_t x2, uint8_t y2, uint8_t color)
{
    OLED_DrawLine(x1, y1, x2, y1, color);
    OLED_DrawLine(x2, y1, x2, y2, color);
    OLED_DrawLine(x2, y2, x1, y2, color);
    OLED_DrawLine(x1, y2, x1, y1, color);
}

/**
  * @brief  画圆（Bresenham 算法）
  */
void OLED_DrawCircle(uint8_t xc, uint8_t yc, uint8_t r, uint8_t color)
{
    int16_t x = 0;
    int16_t y = r;
    int16_t d = 3 - 2 * r;

    while (x <= y)
    {
        OLED_DrawPixel(xc + x, yc + y, color);
        OLED_DrawPixel(xc - x, yc + y, color);
        OLED_DrawPixel(xc + x, yc - y, color);
        OLED_DrawPixel(xc - x, yc - y, color);
        OLED_DrawPixel(xc + y, yc + x, color);
        OLED_DrawPixel(xc - y, yc + x, color);
        OLED_DrawPixel(xc + y, yc - x, color);
        OLED_DrawPixel(xc - y, yc - x, color);

        if (d < 0)
            d += 4 * x + 6;
        else
        {
            d += 4 * (x - y) + 10;
            y--;
        }
        x++;
    }
}
